## sdkconfig.defaults
```kconfig
# StaticTeststandController - ESP32-S3-N16R8 Configuration
# ESP-IDF sdkconfig defaults

# Target: ESP32-S3
CONFIG_IDF_TARGET="esp32s3"

# Flash configuration (16MB)
CONFIG_ESPTOOLPY_FLASHSIZE_16MB=y
CONFIG_ESPTOOLPY_FLASHMODE_QIO=y
CONFIG_ESPTOOLPY_FLASHFREQ_80M=y
CONFIG_PARTITION_TABLE_CUSTOM=y

# PSRAM configuration (8MB OPI)
CONFIG_ESP32S3_SPIRAM_SUPPORT=y
CONFIG_SPIRAM_MODE_OCT=y
CONFIG_SPIRAM_SPEED_80M=y

# FreeRTOS
CONFIG_FREERTOS_HZ=1000
CONFIG_FREERTOS_TIMER_TASK_STACK_DEPTH=4096
CONFIG_FREERTOS_USE_TRACE_FACILITY=y
CONFIG_FREERTOS_GENERATE_RUN_TIME_STATS=n

# WiFi (required for ESP-NOW)
CONFIG_ESP_WIFI_MODE_STA=y

# ESP-NOW
CONFIG_ESP_WIFI_ESPNOW_MAX_ENCRYPT_NUM=0

# Watchdog
CONFIG_ESP_TASK_WDT_TIMEOUT_S=5
CONFIG_ESP_TASK_WDT=y

# Serial output (UART0 - same port used for flashing)
CONFIG_ESP_CONSOLE_UART_DEFAULT=y
CONFIG_ESP_CONSOLE_SECONDARY_NONE=y

# Log level
CONFIG_LOG_DEFAULT_LEVEL_INFO=y
CONFIG_LOG_MAXIMUM_LEVEL_DEBUG=y

# FAT filesystem (for SD card)
CONFIG_FATFS_LONG_FILENAME_SUPPORT=y
CONFIG_FATFS_LFN_HEAP=y
CONFIG_FATFS_MAX_LFN=255

# SPI
CONFIG_SPI_MASTER_ISR_IN_IRAM=y

# NVS
CONFIG_NVS_ENCRYPTION=n
```
