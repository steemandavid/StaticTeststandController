/*******************************************************************************
 * Settings Writer Utility Firmware
 *
 * This is a utility firmware that writes an example settings.txt file
 * to the SD card. Flash this to BASE, run it once, then reflash main firmware.
 *
 * Usage:
 * 1. Build: BUILD_TARGET=BASE idf.py -B build-settings build
 * 2. Flash: idf.py -p /dev/ttyACM0 flash
 * 3. Monitor: idf.py -p /dev/ttyACM0 monitor (look for "Settings file written!")
 * 4. Reflash main firmware
 ******************************************************************************/

#include "config.h"

#ifdef BUILD_TARGET_BASE

#include "driver/spi_master.h"
#include "driver/gpio.h"
#include "esp_log.h"
#include "esp_vfs_fat.h"
#include "sdmmc_cmd.h"
#include "freertos/FreeRTOS.h"
#include "freertos/task.h"
#include <string.h>
#include <stdio.h>

static const char *TAG = "settings_writer";

#define MOUNT_POINT "/sdcard"
#define SETTINGS_PATH "/sdcard/settings.txt"

/* Example settings content */
static const char example_settings[] =
    "# Static Test Stand Controller - Settings File\n"
    "# Generated by settings_writer utility\n"
    "# Lines starting with # are comments\n"
    "# Format: KEY VALUE\n"
    "\n"
    "# Igniter Settings\n"
    "IGNITER_ON_TIME 0.5\n"
    "\n"
    "# ADC Port Assignments (0-7)\n"
    "ADC_PORT_LOADCELL 0\n"
    "ADC_PORT_PRESSURE 1\n"
    "ADC_PORT_IGNITER_SENSE 2\n"
    "ADC_PORT_BREAKWIRE 3 4 5 6\n"
    "\n"
    "# WiFi Settings (for Phase 3 NTP sync)\n"
    "WIFI_SSID YourWiFiSSID\n"
    "WIFI_PASSWORD YourWiFiPassword\n"
    "\n"
    "# ADC Sample Rate (Hz)\n"
    "ADC_SAMPLE_RATE 100\n"
    "\n"
    "# ADC Calibration Values\n"
    "# These should be calibrated for your specific sensors\n"
    "ADC_CAL_LOADCELL 1.0\n"
    "ADC_CAL_PRESSURE 1.0\n"
    "ADC_CAL_IGNITER 1.0\n"
    "ADC_CAL_BREAKWIRE 1.0 1.0 1.0 1.0\n"
    "\n"
    "# Communication Timeouts (seconds)\n"
    "COMMS_WARNING_TIMEOUT 5\n"
    "COMMS_ERROR_TIMEOUT 10\n"
    "\n"
    "# End Test Delay (seconds)\n"
    "# Time to continue logging after burn ends\n"
    "END_TEST_DELAY 5\n"
    "\n"
    "# END OF SETTINGS FILE\n";

void app_main(void)
{
    ESP_LOGI(TAG, "Settings Writer Utility");
    ESP_LOGI(TAG, "=====================");
    ESP_LOGI(TAG, "");
    ESP_LOGI(TAG, "This utility will write an example settings.txt file");
    ESP_LOGI(TAG, "to the SD card on the BASE unit.");

    /* Initialize SPI bus for SD card */
    spi_bus_config_t buscfg = {
        .mosi_io_num = PIN_SD_MOSI,
        .miso_io_num = PIN_SD_MISO,
        .sclk_io_num = PIN_SD_CLK,
        .quadwp_io_num = -1,
        .quadhd_io_num = -1,
        .max_transfer_sz = 4092,
    };

    esp_err_t ret = spi_bus_initialize(SPI2_HOST, &buscfg, SPI_DMA_DISABLED);
    if (ret != ESP_OK && ret != ESP_ERR_INVALID_STATE) {
        ESP_LOGE(TAG, "Failed to initialize SPI bus: %s", esp_err_to_name(ret));
        ESP_LOGE(TAG, "Please check that SD card is connected.");
        return;
    }
    ESP_LOGI(TAG, "SPI bus initialized");

    /* Configure SD card slot */
    sdspi_device_config_t slot_config = SDSPI_DEVICE_CONFIG_DEFAULT();
    slot_config.gpio_cs = PIN_SD_CS;
    slot_config.host_id = SPI2_HOST;

    /* Configure SPI host for SD card */
    sdmmc_host_t host_config = SDSPI_HOST_DEFAULT();
    host_config.slot = SPI2_HOST;
    host_config.max_freq_khz = 16000;

    /* Mount FAT filesystem */
    esp_vfs_fat_mount_config_t mount_config = {
        .max_files = 5,
        .format_if_mount_failed = false,
        .allocation_unit_size = 16 * 1024
    };

    ESP_LOGI(TAG, "Mounting SD card...");
    sdmmc_card_t *card_out;
    ret = esp_vfs_fat_sdspi_mount(MOUNT_POINT, &host_config, &slot_config, &mount_config, &card_out);
    if (ret != ESP_OK) {
        ESP_LOGE(TAG, "Failed to mount SD card: %s", esp_err_to_name(ret));
        ESP_LOGE(TAG, "Please check:");
        ESP_LOGE(TAG, "  1. SD card is inserted");
        ESP_LOGE(TAG, "  2. SD card is formatted as FAT32");
        ESP_LOGE(TAG, "  3. Wiring is correct (CS=%d, MOSI=%d, MISO=%d, CLK=%d)",
                 PIN_SD_CS, PIN_SD_MOSI, PIN_SD_MISO, PIN_SD_CLK);
        return;
    }
    ESP_LOGI(TAG, "SD card mounted successfully");

    /* Print SD card info */
    if (card_out) {
        ESP_LOGI(TAG, "SD card info:");
        ESP_LOGI(TAG, "  Name: %s", card_out->cid.name);
        ESP_LOGI(TAG, "  Capacity: %llu MB", ((uint64_t)card_out->csd.capacity) * 512 / 1024 / 1024);
    }

    /* Write settings file */
    ESP_LOGI(TAG, "Writing settings file: %s", SETTINGS_PATH);
    FILE *f = fopen(SETTINGS_PATH, "w");
    if (f == NULL) {
        ESP_LOGE(TAG, "Failed to create settings file");
        esp_vfs_fat_sdcard_unmount(MOUNT_POINT, card_out);
        return;
    }

    size_t written = fwrite(example_settings, 1, sizeof(example_settings) - 1, f);
    fclose(f);

    if (written != sizeof(example_settings) - 1) {
        ESP_LOGE(TAG, "Failed to write complete settings file");
        esp_vfs_fat_sdcard_unmount(MOUNT_POINT, card_out);
        return;
    }

    ESP_LOGI(TAG, "Settings file written successfully!");
    ESP_LOGI(TAG, "");
    ESP_LOGI(TAG, "File contents:");
    ESP_LOGI(TAG, "====================");
    ESP_LOGI(TAG, "%s", example_settings);
    ESP_LOGI(TAG, "====================");
    ESP_LOGI(TAG, "");

    /* Unmount SD card */
    esp_vfs_fat_sdcard_unmount(MOUNT_POINT, card_out);
    ESP_LOGI(TAG, "SD card unmounted");

    ESP_LOGI(TAG, "");
    ESP_LOGI(TAG, "==========================================");
    ESP_LOGI(TAG, "SETTINGS FILE WRITTEN SUCCESSFULLY!");
    ESP_LOGI(TAG, "==========================================");
    ESP_LOGI(TAG, "");
    ESP_LOGI(TAG, "Next steps:");
    ESP_LOGI(TAG, "  1. Power off the BASE unit");
    ESP_LOGI(TAG, "  2. Remove the SD card");
    ESP_LOGI(TAG, "  3. Verify settings.txt exists on the SD card");
    ESP_LOGI(TAG, "  4. Reinsert SD card and power on BASE");
    ESP_LOGI(TAG, "  5. Flash main firmware: BUILD_TARGET=BASE idf.py flash");
    ESP_LOGI(TAG, "");
    ESP_LOGI(TAG, "You can edit settings.txt on your computer to");
    ESP_LOGI(TAG, "customize the values for your hardware.");
    ESP_LOGI(TAG, "");

    /* Blink LED to indicate completion */
    gpio_config_t led_cfg = {
        .pin_bit_mask = (1ULL << PIN_LED_BUILTIN),
        .mode = GPIO_MODE_OUTPUT,
        .pull_up_en = GPIO_PULLUP_DISABLE,
        .pull_down_en = GPIO_PULLDOWN_DISABLE,
        .intr_type = GPIO_INTR_DISABLE,
    };
    gpio_config(&led_cfg);

    ESP_LOGI(TAG, "Blinking LED 3 times to indicate completion...");
    for (int i = 0; i < 3; i++) {
        gpio_set_level(PIN_LED_BUILTIN, 1);
        vTaskDelay(pdMS_TO_TICKS(200));
        gpio_set_level(PIN_LED_BUILTIN, 0);
        vTaskDelay(pdMS_TO_TICKS(200));
    }

    ESP_LOGI(TAG, "Done! You can now flash the main firmware.");
}

#endif /* BUILD_TARGET_BASE */
